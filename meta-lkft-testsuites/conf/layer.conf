## meta-lkft-testsuites/conf/layer.conf
```bitbake
# We might have a conf and classes directory, append to BBPATH
BBPATH .= ":${LAYERDIR}"

# We have a recipes directory, add to BBFILES
BBFILES += "${LAYERDIR}/recipes*/*/*.bb ${LAYERDIR}/recipes*/*/*.bbappend"

BBFILE_COLLECTIONS += "meta-lkft-testsuites"
BBFILE_PATTERN_meta-lkft-testsuites := "^${LAYERDIR}/"
BBFILE_PRIORITY_meta-lkft-testsuites = "8"

LAYERSERIES_COMPAT_meta-lkft-testsuites = "kirkstone"
```

## meta/conf/distro/lkft.conf
```bitbake
DISTRO_NAME = "Linux-Kernel-Functional-Testing"

DISTRO_FEATURES:remove = "opengl sysvinit"
DISTRO_FEATURES:append = " systemd"

PACKAGECONFIG:append:pn-systemd = " resolved networkd"

CMDLINE:remove = "quiet"

PREFERRED_PROVIDER_virtual/kernel ?= "linux-generic-mainline"
MACHINE_HWCODECS:intel-corei7-64 = ""
MACHINE_HWCODECS:intel-core2-32 = ""
IMAGE_FSTYPES:remove = "ext4 iso wic wic.bmap wic.gz wic.xz tar.bz2"
IMAGE_FSTYPES:append = " ext4.gz tar.xz"

INHERIT += "image-buildinfo"

EXTRA_IMAGECMD:juno:ext4 += " -L rootfs "

# `fold' is needed for recent kernels (4.20+)
HOSTTOOLS += "fold"

PACKAGECONFIG:remove:qemumips = "coresight"
PACKAGECONFIG:remove:pn-qemu = "sdl"
SECURITY_STACK_PROTECTOR:pn-ltp = ""

VIRTUAL-RUNTIME_init_manager = "systemd"

# Read kernel parameters for LKFT, if there's any
include conf/lkft-kernel.conf
```
